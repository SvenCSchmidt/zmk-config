## boards/mangoiv/le_chiff_ble/Kconfig.defconfig
```kconfig
# Copyright (c) 2021 @MangoIV
# SPDX-License-Identifier: MIT

if BOARD_LE_CHIFF_BLE

config ZMK_KEYBOARD_NAME
	default "BLE Chiffre"

if USB_DEVICE_STACK

config USB_NRFX
	default y

endif # USB_DEVICE_STACK

config BT_CTLR
	default BT

config ZMK_BATTERY_VOLTAGE_DIVIDER
	default y

endif # BOARD_LE_CHIFF_BLE
```

## boards/mangoiv/le_chiff_ble/Kconfig.le_chiff_ble
```kconfig
# Copyright (c) 2021 @MangoIV
# SPDX-License-Identifier: MIT

config BOARD_LE_CHIFF_BLE
    select SOC_NRF52840_QIAA
    select ZMK_BOARD_COMPAT if BOARD_LE_CHIFF_BLE_NRF52840_ZMK
    imply RETAINED_MEM if BOARD_LE_CHIFF_BLE_NRF52840_ZMK
    imply RETENTION if BOARD_LE_CHIFF_BLE_NRF52840_ZMK
    imply RETENTION_BOOT_MODE if BOARD_LE_CHIFF_BLE_NRF52840_ZMK
```

## boards/mangoiv/le_chiff_ble/board.yml
```yaml
board:
  name: le_chiff_ble
  full_name: Le Chiffre BLE
  vendor: mangoiv
  socs:
    - name: nrf52840
      variants:
        - name: zmk
```

## boards/shields/cornholius/Kconfig.cornholius
```kconfig
# Copyright (c) 2020 The ZMK Contributors
# SPDX-License-Identifier: MIT

config BOARD_CORNHOLIUS
    select SOC_NRF52840_QIAA
    select ZMK_BOARD_COMPAT if BOARD_CORNHOLIUS_NRF52840_ZMK
    imply RETAINED_MEM if BOARD_CORNHOLIUS_NRF52840_ZMK
    imply RETENTION if BOARD_CORNHOLIUS_NRF52840_ZMK
    imply RETENTION_BOOT_MODE if BOARD_CORNHOLIUS_NRF52840_ZMK
```

## boards/shields/cornholius/Kconfig.defconfig
```kconfig
# Copyright (c) 2020 The ZMK Contributors
# SPDX-License-Identifier: MIT

if BOARD_CORNHOLIUS

config ZMK_KEYBOARD_NAME
	default "Cornholius"

if USB_DEVICE_STACK

config USB_NRFX
	default y

endif # USB_DEVICE_STACK

config BT_CTLR
	default BT

config I2C
	default y

config MAX17048
	default y

endif # BOARD_CORNHOLIUS
```

## boards/shields/cornholius/board.yml
```yaml
board:
  name: cornholius
  full_name: Cornholius
  vendor: ebastler
  socs:
    - name: nrf52840
      variants:
        - name: zmk
```

## boards/shields/le_chiffre_stm32/Kconfig.defconfig
```kconfig
# Copyright (c) 2020 The ZMK Contributors
# SPDX-License-Identifier: MIT

if BOARD_LE_CHIFFRE_STM32

config ZMK_KEYBOARD_NAME
	default "Le Chiffre 36"

endif # BOARD_LE_CHIFFRE_STM32
```

## boards/shields/le_chiffre_stm32/Kconfig.le_chiffre_stm32
```kconfig
# Copyright (c) 2020 The ZMK Contributors
# SPDX-License-Identifier: MIT

config BOARD_LE_CHIFFRE_STM32
    select SOC_STM32F072XB
    select ZMK_BOARD_COMPAT if BOARD_LE_CHIFFRE_STM32_STM32F072XB_ZMK
```

## boards/shields/le_chiffre_stm32/board.yml
```yaml
board:
  name: le_chiffre_stm32
  full_name: Le Chiffre (STM32)
  vendor: sporkus
  socs:
    - name: stm32f072xb
      variants:
        - name: zmk
```

## boards/shields/onyxcinder/Kconfig.defconfig
```kconfig
if SHIELD_ONYXCINDER

config ZMK_KEYBOARD_NAME
    default "Onyx Cinder"

config SPI
    default y

endif
```

## boards/shields/splaytoraid36/Kconfig.defconfig
```kconfig
if SHIELD_SPLAYTORAID36

config ZMK_KEYBOARD_NAME
    default "Splaytoraid36"

endif
```

## boards/shields/splaytoraid40/Kconfig.defconfig
```kconfig
if SHIELD_SPLAYTORAID40

config ZMK_KEYBOARD_NAME
    default "Splaytoraid40"

endif
```

## boards/shields/tipper_tf/Kconfig.defconfig
```kconfig
# Copyright (c) 2021 @weteor
# SPDX-License-Identifier: MIT

if BOARD_TIPPER_TF

config ZMK_KEYBOARD_NAME
	default "Tipper TF"

if USB_DEVICE_STACK

config USB_NRFX
	default y

endif # USB_DEVICE_STACK

config BT_CTLR
	default BT

config ZMK_BATTERY_VOLTAGE_DIVIDER
	default y

endif # BOARD_TIPPER_TF
```

## boards/shields/tipper_tf/Kconfig.tipper_tf
```kconfig
# Copyright (c) 2021 @weteor
# SPDX-License-Identifier: MIT

config BOARD_TIPPER_TF
    select SOC_NRF52840_QIAA
    select ZMK_BOARD_COMPAT if BOARD_TIPPER_TF_NRF52840_ZMK
    imply RETAINED_MEM if BOARD_TIPPER_TF_NRF52840_ZMK
    imply RETENTION if BOARD_TIPPER_TF_NRF52840_ZMK
    imply RETENTION_BOOT_MODE if BOARD_TIPPER_TF_NRF52840_ZMK
```

## boards/shields/tipper_tf/board.yml
```yaml
board:
  name: tipper_tf
  full_name: Tipper TF
  vendor: weteor
  socs:
    - name: nrf52840
      variants:
        - name: zmk
```

## drivers/display/Kconfig
```kconfig
# Copyright (c) 2021 The ZMK Contributors
# SPDX-License-Identifier: MIT

if DISPLAY

rsource "Kconfig.jd79653"

endif # DISPLAY
```

## drivers/display/Kconfig.jd79653
```kconfig
# JD79653 EPD controller (GoodDisplay GDEW0154M09)

# Copyright (c) 2020 Phytec Messtechnik GmbH
# SPDX-License-Identifier: Apache-2.0

config JD79653
	bool "JD79653 compatible display controller driver"
	depends on SPI
	help
	  Enable driver for the JD79653 (GoodDisplay GDEW0154M09) EPD controller.
	  Ported from weteor's ZMK fork to the current Zephyr display/SPI/GPIO API
	  (mirrors ZMK's in-tree il0323 driver).
```
